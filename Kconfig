## src/arch/asm-cortex-m/Kconfig
```kconfig
config HAS_DCACHE
	bool

config HAS_ICACHE
	bool

config HAS_FPU
	bool

config HAS_FPU_VFPV3
	bool

config HAS_FPU_VFPV4
	bool

config HAS_FPU_FPV5
	bool

config HAS_MPU
	bool

config HAS_NVIC
	bool

config THUMB
	bool

config LITTLE_ENDIAN
	bool

config BIG_ENDIAN
	bool

config HAS_DWT
	bool

config ARCH_ARM_CORTEX_M3
	bool

config ARCH_ARM_CORTEX_M4
	bool

config ARCH_ARM_CORTEX_M7
	bool

config ARCH_ARM_CORTEX_M33
	bool

config ARCH_SOCNAME
	string
	default "STM32F4" if ARCH_MCU_STM32F4
	default "STM32U5" if ARCH_MCU_STM32U5

choice
	bool "target SoC selection"
config ARCH_MCU_STM32U5
	bool "STM32U5"
	select ARCH_ARM_CORTEX_M
	select ARCH_ARM_CORTEX_M33
	select HAS_DCACHE
	select HAS_ICACHE
	select HAS_FPU
	select HAS_FPU_FPV5
	select HAS_MPU
	select HAS_NVIC
	select THUMB
	select LITTLE_ENDIAN
	select HAS_DWT

config ARCH_MCU_STM32F4
	bool "STM32F4"
	select ARCH_ARM_CORTEX_M
	select ARCH_ARM_CORTEX_M4
	select HAS_DCACHE
	select HAS_ICACHE
	select HAS_FPU
	select HAS_FPU_VFPV4
	select HAS_MPU
	select HAS_NVIC
	select THUMB
	select LITTLE_ENDIAN
	select HAS_DWT

endchoice

if HAS_FPU

choice
	bool "floating point ABI"
config FPU_SOFT_ABI
	bool "soft"
config FPU_SOFTFP_ABI
	bool "soft-fp"
	depends on HAS_FPU
config FPU_HARDFP_ABI
	bool "hard-fp"
	depends on HAS_FPU
endchoice

config USE_FPU
	bool
	default y if FPU_HARDFP_ABI
	default y if FPU_SOFTFP_ABI

comment "VFPv3 FPU not available for this target arch"
	depends on !HAS_FPU_VFPV3

comment "VFPv4 FPU not available for this target arch"
	depends on !HAS_FPU_VFPV4

comment "FPv5 FPU not available for this target arch"
	depends on !HAS_FPU_FPV5

choice
	bool "FPv5 float precision"
	depends on HAS_FPU_FPV5
	help
	  Choose floating precision (single/double) to use for FPv5 floating point unit
config FPV5_SP
	bool "single precision"
config FPV5_DP
	bool "double precision"
endchoice

endif

config FPU_ABI_CFLAGS
	string
	default "-mfloat-abi=soft" if FPU_SOFT_ABI
	default "-mfloat-abi=softfp" if FPU_SOFTFP_ABI
	default "-mfloat-abi=hard" if FPU_HARDFP_ABI

config FPU_CFLAGS
	string
	depends on !FPU_SOFT_ABI
	depends on HAS_FPU && (HAS_FPU_VFPV3 || HAS_FPU_VFPV4 || HAS_FPU_FPV5)
	default "-mfpu=vfpv4-d16" if HAS_FPU_VFPV4
	default "-mfpu=fpv5-d16" if HAS_FPU_FPV5 && FPV5_DP
	default "-mfpu=fpv5-sp-d16" if HAS_FPU_FPV5 && FPV5_SP && !FPV5_DP

config ISA_CFLAGS
	string
	default "-mthumb" if THUMB

config ENDIANNESS_CFLAGS
	string
	default "-mlittle-endian" if LITTLE_ENDIAN
	default "-mbig-endian" if BIG_ENDIAN

config CPU_CFLAGS
	string
	default "-mcpu=cortex-m3" if ARCH_ARM_CORTEX_M3
	default "-mcpu=cortex-m4" if ARCH_ARM_CORTEX_M4
	default "-mcpu=cortex-m7" if ARCH_ARM_CORTEX_M7
	default "-mcpu=cortex-m33" if ARCH_ARM_CORTEX_M33
```

## src/core/Kconfig
```kconfig
menu "Core functions"

config MAX_TASKS
	int "Maximum number of userspace tasks"
	range 1 256
	default 8
	help
	  Maximum number of userspace tasks, from 1 to 256


choice
	bool "Scheduling policy"
	default SCHED_FIFO
config SCHED_FIFO
	bool "FIFO-based policy"
	help
	  Schedule task with FIFO scheduling policy. Each task is executed
	  while not entering a blocking syscall (yield, sleep, etc.). The
	  task is eligible again each time an input event is received (IPC, signal,
	  interrupt)

endchoice

endmenu
```

## src/managers/Kconfig
```kconfig
menu "Managers"

menu "Task manager"

config SVC_EXCHANGE_AREA_LEN
	int "Size of the SVC_Exhcange area"
	range 64 1024
	default 128
	help
	  length (in bytes) of the user/kernel exchange area

config TASK_MAGIC_VALUE
	hex "task magic value number"
	default 0xdeadcafe
	help
	  Default tasks magic number value to be set for all
	  tasks. this value is specific to each project so
	  that when building tasks for a given project, only these
	  tasks can be added to the kernel bin

config MAX_DEV_PER_TASK
	int "max devices per task"
	range 0 8
	default 4
	help
	  Maximum number of declared device per task

config MAX_SHM_PER_TASK
	int "Maximum mumber of SHM per task"
	range 0 8
	default 4
	help
	  Maximum number of owned shared memory per task

config MAX_DMA_STREAMS_PER_TASK
	int "Maximum mumber of DMA streams per task"
	range 0 8
	default 4
	help
      Maximum number of declared DMA streams per task

endmenu

endmenu
```

## src/security/Kconfig
```kconfig
menu "Security"

# symbols selected by build mode
config SECU_SSP_USER
	bool
	# support for user threads stack canaries

config SECU_SSP_KERN
	bool
	# support for kernel threads stack canaries

config SECU_HW_SETNCHECK
	bool
	---help---
	  when possible (may depend on the hardware device), double verify that
	  the target register configuration is valid and active
	# Unable set and check of critical hardware registers
	# (iowrite + ioread and compare)

config SECU_NO_WEAKTYPES
	bool
	---help---
	  Comparison to 0 lead to potential weak optimizations that should be
	  avoided in security critical environment. In the same way, hamming distance
	  of 1 can be easily faulted, in comparison with a discrete type

config SECU_LOOP_DBLE_IDX
	bool
	# Double index count and check in critical loops

config SECU_TASK_INTEGRITY_AT_BOOT
	bool

config SECU
	bool

endmenu
```
