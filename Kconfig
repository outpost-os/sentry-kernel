## Kconfig
```kconfig
# SPDX-FileCopyrightText: 2023-2024 Ledger SAS
# SPDX-License-Identifier: Apache-2.0

mainmenu "Sentry kernel"

rsource 'kernel/Kconfig'

rsource 'autotest/Kconfig'
```

## autotest/Kconfig
```kconfig
# SPDX-FileCopyrightText: 2023-2024 Ledger SAS
# SPDX-License-Identifier: Apache-2.0

if BUILD_TARGET_AUTOTEST

menu "Autotest configuration"

config TEST_YIELD
    bool "yield test suite"
    default y

config TEST_HANDLES
    bool "handles access test suite"
    default y

config TEST_SIGNALS
    bool "Signal snd/receive test suite"
    default y

config TEST_IPC
    bool "IPC snd/receive test suite"
    default y

config TEST_RANDOM
    bool "KRNG test suite"
    default y

config TEST_CYCLES
    bool "Cycle measurement test suite"
    default y

config TEST_SLEEP
    bool "Various slepping mode test suite"
    default y

config TEST_GPIO
    bool "GPIO kernel API test suite"
    default n

config TEST_DEVICES
    bool "devices (un)mapping and access API test suite"
    default n

config TEST_SHM
    bool "Shared memory manipulation test suite"
    default y

config TEST_DMA
    bool "Shared memory manipulation test suite"
    default n

endmenu

endif
```

## configs/nucleo_l476rg_debug_defconfig
```kconfig
# SPDX-FileCopyrightText: 2023-2024 Ledger SAS
# SPDX-License-Identifier: Apache-2.0

CONFIG_ARCH_MCU_STM32L476=y
CONFIG_STANDALONE_MODE=y
```

## configs/nucleo_u5a5_autotest_defconfig
```kconfig
CONFIG_ARCH_MCU_STM32U5A5=y
CONFIG_FPU_SOFTFP_ABI=y
CONFIG_DRV_STM32_LPUART=y
CONFIG_STANDALONE_MODE=y
CONFIG_BUILD_TARGET_AUTOTEST=y
```

## configs/nucleo_u5a5_defconfig
```kconfig
# SPDX-FileCopyrightText: 2023-2024 Ledger SAS
# SPDX-License-Identifier: Apache-2.0

CONFIG_ARCH_MCU_STM32U5A5=y
CONFIG_FPU_SOFTFP_ABI=y
CONFIG_DRV_STM32_LPUART=y
CONFIG_STANDALONE_MODE=y
```

## configs/nucleo_u5a5_nooutput_defconfig
```kconfig
CONFIG_ARCH_MCU_STM32U5A5=y
CONFIG_FPU_SOFTFP_ABI=y
CONFIG_DEBUG_OUTPUT_NONE=y
CONFIG_STANDALONE_MODE=y
```

## configs/stm32f429i_disc1_debug_defconfig
```kconfig
# SPDX-FileCopyrightText: 2023-2024 Ledger SAS
# SPDX-License-Identifier: Apache-2.0

CONFIG_ARCH_MCU_STM32F429=y
CONFIG_STANDALONE_MODE=y
```

## configs/stm32f429i_disc1_defconfig
```kconfig
CONFIG_ARCH_MCU_STM32F4=y
CONFIG_STANDALONE_MODE=y
CONFIG_DTS_FILE="dts/sentry_stm32f429i_disc1.dts"
CONFIG_ARCH_MCU_STM32F429=y
```

## configs/stm32f429i_disc1_release_defconfig
```kconfig
CONFIG_ARCH_MCU_STM32F429=y
CONFIG_STANDALONE_MODE=y
CONFIG_BUILD_TARGET_RELEASE=y
```

## configs/stm32f4_debug_defconfig
```kconfig
CONFIG_ARCH_MCU_STM32F4=y
CONFIG_STANDALONE_MODE=y
CONFIG_DTS_FILE="dts/sentry_sample_stm32f4.dts"
```

## configs/stm32l476rg_debug_defconfig
```kconfig
CONFIG_ARCH_MCU_STM32L476=y
CONFIG_STANDALONE_MODE=y
CONFIG_DTS_FILE="dts/sentry_sample_stm32l4.dts"
```

## kernel/Kconfig
```kconfig
rsource 'src/arch/Kconfig'
rsource 'src/drivers/Kconfig'
rsource 'src/startup/Kconfig'
rsource 'src/managers/Kconfig'

menu "Build mode"

config STANDALONE_MODE
	bool "Standardone mode"
	help
	  Allows standalone mode. No external task is built, Sentry only
	  execute itself and its own services and platform init.
	  Useful for basic platform debug and testing and architecture port

# debug relative options. Only set through build type. For security relative
# see src/security/Kconfig
config BUILD_WITH_GDB
	bool


choice
	bool "Build type"
config BUILD_TARGET_DEBUG
	bool "Build in debug mode"
	help
	  Allows ggdb support, debug options, disable hardening and optimisation that
	  may br ptoblematic for debugging purpose.
	  MUST NOT BE USED FOR DELIVERY.
	select BUILD_WITH_GDB

config BUILD_TARGET_RELEASE
	bool "Build in release mode"
	help
	  Remove all debugging-relative flags, activate all hardening mechanisms
	select SECU_SSP_USER
	select SECU_SSP_KERN
	select SECU_HW_SETNCHECK
	select SECU_NO_COMPTOZERO
	select SECU_LOOP_DBLE_IDX

config BUILD_TARGET_AUTOTEST
	bool "Built Sentry in autotest mode"
	help
	  Build autotest task and activate kernel autotest flag. The kernel
	  do no more parse the task metadata table but instead load the autotest
	  app and enable autotest mode in managers and syscalls kernel-side.
	  This allows a lot of runtime-testing, that can be controlled through
	  a dedicated, autotest-enabled specific syscall used by the autotest app,
	  that can be triggered through a serial communication with a CI or a test PC
	  to generate Sentry test reports.
	select SECU_SSP_USER
	select SECU_SSP_KERN
	select SECU_HW_SETNCHECK
	select SECU_NO_COMPTOZERO
	select SECU_LOOP_DBLE_IDX
endchoice

config WITH_JTAG_CONNECTED
	bool "Built for target with JTAG connected, active auto-breakpoints"
	default n
	depends on BUILD_TARGET_DEBUG || BUILD_TARGET_AUTOTEST

endmenu
```

## kernel/src/arch/Kconfig
```kconfig
menu "Platform support"

config ARCH_ARM_CORTEX_M
	bool

choice
	bool "Target arch selection"
config ARCH_ARM
	bool "ARM Cortex-M target & SoCs"

endchoice

if ARCH_ARM
rsource 'asm-cortex-m/Kconfig'
endif


endmenu
```

## kernel/src/arch/asm-cortex-m/Kconfig
```kconfig
# masked symbols. These symbols are automatically selected based on the
# target SoC.
# The target SoC define the core technology, and thus the core features

config ARCH_ARM_CORTEX_M3
	bool

config ARCH_ARM_CORTEX_M4
	bool

config ARCH_ARM_CORTEX_M7
	bool

config ARCH_ARM_CORTEX_M33
	bool

config ARCH_ARM_CORTEX_M35P
	bool

config HAS_DCACHE
	bool

config HAS_ICACHE
	bool

config HAS_FPU
	bool

config HAS_FPU_VFPV3
	bool

config HAS_FPU_VFPV4
	bool

config HAS_FPU_FPV5
	bool

config HAS_MPU
	bool

config HAS_MPU_PMSA_V7
	bool

config HAS_MPU_PMSA_V8
	bool

config NUM_MPU_REGIONS
	int "number of MPU regions"
	depends on HAS_MPU
	default 8
	help
	  Number of MPU region, this is vendor defined, 8 by default.

# TODO Add secure MPU feature

config HAS_NVIC
	bool

config THUMB
	bool

config LITTLE_ENDIAN
	bool

config BIG_ENDIAN
	bool

config HAS_DWT
	bool

config HAS_RNG
	bool

config HAS_FLASH_DUAL_BANK
	bool

config ARCH_ARM_ARMV7M
    bool
	select HAS_MPU
	select HAS_MPU_PMSA_V7
	select HAS_NVIC
	select THUMB
	select LITTLE_ENDIAN
	select HAS_DWT

config ARCH_ARM_ARMV8M
    bool
	select HAS_MPU
	select HAS_MPU_PMSA_V8
	select HAS_NVIC
	select THUMB
	select LITTLE_ENDIAN
	select HAS_DWT



config SOC_FAMILY_STM32
	bool

config SOC_SUBFAMILY_STM32F4
	bool

config SOC_SUBFAMILY_STM32F4x5_7
	bool
	help
	  "STM32F405/F407/F415/F417 soc sub family"

config SOC_SUBFAMILY_STM32F42_3xx
	bool
	help
	  "STM32F427/F429/F437/F439 soc sub family"

config SOC_SUBFAMILY_STM32L4
	bool

config SOC_SUBFAMILY_STM32L47_8x
	bool
	help
	  "STM32L47x/L48x soc sub family"

config SOC_SUBFAMILY_STM32L49_Ax
	bool
	help
	  "STM32L49x/L4Ax soc sub family"

config SOC_SUBFAMILY_STM32U5
	bool

config SOC_SUBFAMILY_STM32U535_545
	bool

config SOC_SUBFAMILY_STM32U535_545
	bool

config SOC_SUBFAMILY_STM32U575_585
	bool

config SOC_SUBFAMILY_STM32U59_Ax
	bool

config SOC_SUBFAMILY_STM32U5F_Gx
	bool

config SOC_SUBFAMILY_STM32WB
	bool

config ARCH_ARM_CORTEX_NAME
    string
	default "m4" if ARCH_MCU_STM32WB55
	default "m4" if SOC_SUBFAMILY_STM32F4
	default "m4" if SOC_SUBFAMILY_STM32L4
	default "m33" if SOC_SUBFAMILY_STM32U5

config ARCH_SOCNAME
	string
	default "STM32WB55" if ARCH_MCU_STM32WB55
	default "STM32F401" if ARCH_MCU_STM32F401
	default "STM32F407" if ARCH_MCU_STM32F407
	default "STM32F419" if ARCH_MCU_STM32F419
	default "STM32F429" if ARCH_MCU_STM32F429
	default "STM32F439" if ARCH_MCU_STM32F439
	default "STM32L476" if ARCH_MCU_STM32L476
	default "STM32U5A5" if ARCH_MCU_STM32U5A5

# User-accessible selectors

choice
	bool "target SoC selection"
	default ARCH_MCU_STM32F439

config ARCH_MCU_STM32F439
	bool "STM32F439"
	select ARCH_ARM_CORTEX_M
	select ARCH_ARM_ARMV7M
	select HAS_DCACHE
	select HAS_ICACHE
	select HAS_FPU
	select HAS_FPU_VFPV4
	select HAS_RNG
	select HAS_FLASH_DUAL_BANK
	select SOC_FAMILY_STM32
	select SOC_SUBFAMILY_STM32F4
	select SOC_SUBFAMILY_STM32F42_3xx

config ARCH_MCU_STM32F429
	bool "STM32F429"
	select ARCH_ARM_CORTEX_M
	select ARCH_ARM_ARMV7M
	select HAS_DCACHE
	select HAS_ICACHE
	select HAS_FPU
	select HAS_FPU_VFPV4
	select HAS_RNG
	select HAS_FLASH_DUAL_BANK
	select SOC_FAMILY_STM32
	select SOC_SUBFAMILY_STM32F4
	select SOC_SUBFAMILY_STM32F42_3xx

config ARCH_MCU_STM32F407
	bool "STM32F407"
	select ARCH_ARM_CORTEX_M
	select ARCH_ARM_ARMV7M
	select HAS_DCACHE
	select HAS_ICACHE
	select HAS_FPU
	select HAS_FPU_VFPV4
	select HAS_RNG
	select SOC_FAMILY_STM32
	select SOC_SUBFAMILY_STM32F4
	select SOC_SUBFAMILY_STM32F4x5_7

config ARCH_MCU_STM32F401
	bool "STM32F401"
	select ARCH_ARM_CORTEX_M
	select ARCH_ARM_ARMV7M
	select HAS_DCACHE
	select HAS_ICACHE
	select HAS_FPU
	select HAS_FPU_VFPV4
	select SOC_FAMILY_STM32
	select SOC_SUBFAMILY_STM32F4

config ARCH_MCU_STM32WB55
	bool "STM32WB55"
	select ARCH_ARM_CORTEX_M
	select ARCH_ARM_ARMV7M
	select HAS_DCACHE
	select HAS_ICACHE
	select HAS_FPU
	select HAS_FPU_VFPV4
	select SOC_FAMILY_STM32
	select SOC_SUBFAMILY_STM32WB

config ARCH_MCU_STM32L476
	bool "STM32L476"
	select ARCH_ARM_CORTEX_M
	select ARCH_ARM_ARMV7M
	select HAS_FPU
	select HAS_FPU_VFPV4
	select HAS_DCACHE
	select HAS_ICACHE
	select SOC_FAMILY_STM32
	select SOC_SUBFAMILY_STM32L4
	select SOC_SUBFAMILY_STM32L47_8x

config ARCH_MCU_STM32U5A5
	bool "STM32U5A5"
	select ARCH_ARM_CORTEX_M
	select ARCH_ARM_ARMV8M
	select HAS_DCACHE
	select HAS_ICACHE
	select HAS_FPU
	select HAS_FPU_FPV5
	select HAS_RNG
	select SOC_FAMILY_STM32
	select SOC_SUBFAMILY_STM32U5
	select SOC_SUBFAMILY_STM32U59_Ax

endchoice

if HAS_FPU

choice
	bool "floating point ABI"
config FPU_SOFT_ABI
	bool "soft"
config FPU_SOFTFP_ABI
	bool "soft-fp"
	depends on HAS_FPU
config FPU_HARDFP_ABI
	bool "hard-fp"
	depends on HAS_FPU
endchoice

config USE_FPU
	bool
	default y if FPU_HARDFP_ABI
	default y if FPU_SOFTFP_ABI

comment "VFPv3 FPU not available for this target arch"
	depends on !HAS_FPU_VFPV3

comment "VFPv4 FPU not available for this target arch"
	depends on !HAS_FPU_VFPV4

comment "FPv5 FPU not available for this target arch"
	depends on !HAS_FPU_FPV5

choice
	bool "FPv5 float precision"
	depends on HAS_FPU_FPV5
	help
	  Choose floating precision (single/double) to use for FPv5 floating point unit
config FPV5_SP
	bool "single precision"
config FPV5_DP
	bool "double precision"
endchoice

endif

config FPU_ABI_CFLAGS
	string
	default "-mfloat-abi=soft" if FPU_SOFT_ABI
	default "-mfloat-abi=softfp" if FPU_SOFTFP_ABI
	default "-mfloat-abi=hard" if FPU_HARDFP_ABI

config FPU_CFLAGS
	string
	depends on !FPU_SOFT_ABI
	depends on HAS_FPU && (HAS_FPU_VFPV3 || HAS_FPU_VFPV4 || HAS_FPU_FPV5)
	default "-mfpu=vfpv4-d16" if HAS_FPU_VFPV4
	default "-mfpu=fpv5-d16" if HAS_FPU_FPV5 && FPV5_DP
	default "-mfpu=fpv5-sp-d16" if HAS_FPU_FPV5 && FPV5_SP && !FPV5_DP

config ISA_CFLAGS
	string
	default "-mthumb" if THUMB

config ENDIANNESS_CFLAGS
	string
	default "-mlittle-endian" if LITTLE_ENDIAN
	default "-mbig-endian" if BIG_ENDIAN

config SYSTICK_HZ
	int "systick initial period configuration"
	range 0 10000
	default 1000
```

## kernel/src/core/Kconfig
```kconfig
menu "Core functions"

config MAX_TASKS
	int "Maximum number of userspace tasks"
	range 1 256
	default 8
	help
	  Maximum number of userspace tasks, from 1 to 256


choice
	bool "Scheduling policy"
	default SCHED_RRMQ
config SCHED_RRMQ
	bool "Round-Robin Multiqueue with Quantum scheduler policy"
	help
	  Schedule task with multiqueue round-robin, with elastic quantum support
	  Allows differenciated quantum per task, with timeslotting-based task sets
	  Highly efficient when well configured.
	  A task can yield() before its quantum end to refresh it. Blocking syscalls
	  (IPC, sleep) also refresh the quantum.
config SCHED_FIFO
	bool "FIFO-based policy"
	help
	  Schedule task with FIFO scheduling policy. Each task is executed
	  while not entering a blocking syscall (yield, sleep, etc.). The
	  task is eligible again each time an input event is received (IPC, signal,
	  interrupt)

endchoice

endmenu
```

## kernel/src/managers/Kconfig
```kconfig
menu "Managers"

menu "Task manager"

config SVC_EXCHANGE_AREA_LEN
	int "Size of the SVC_Exchange area"
	range 64 1024
	default 128
	help
	  length (in bytes) of the user/kernel exchange area

config TASK_MAGIC_VALUE
	hex "task magic value number"
	default 0xdeadcafe
	help
	  Default tasks magic number value to be set for all
	  tasks. this value is specific to each project so
	  that when building tasks for a given project, only these
	  tasks can be added to the kernel bin

config MAX_DEV_PER_TASK
	int "max devices per task"
	range 0 8
	default 4
	help
	  Maximum number of declared device per task

config MAX_SHM_PER_TASK
	int "Maximum mumber of SHM per task"
	range 0 8
	default 4
	help
	  Maximum number of owned shared memory per task

config MAX_DMA_STREAMS_PER_TASK
	int "Maximum mumber of DMA streams per task"
	range 0 8
	default 4
	help
      Maximum number of declared DMA streams per task

endmenu

if !BUILD_TARGET_RELEASE

menu "Debug manager"

config DEBUG_COLORS
	bool "Support for ANSI colors support"
	default n
	help
	  Activate ANSI coloration on serial console for kernel debugging
	  output. Userspace log is not impacted

if DEBUG_COLORS

choice
	bool "ANSI color mode"
	default DEBUG_COLORS_REGULAR
config DEBUG_COLORS_REGULAR
	bool "regular message highlighting"
	help
	  kernel messages are highighted using foreground color, regular mode
config DEBUG_COLORS_BOLD
	bool "bold message highlighting"
	help
	  kernel messages are highighted using foreground color, bold mode
config DEBUG_COLORS_BACKGROUND
	bool "background message highlighting"
	help
	  kernel messages are highighted using background color
endchoice

choice
	bool "Default text color"
	default DEBUG_COLOR_DEFAULT_WHITE
config DEBUG_COLOR_DEFAULT_WHITE
	bool "default text color to white"
config DEBUG_COLOR_DEFAULT_BLACK
	bool "default text color to black"
endchoice


endif

config DEBUG_LEVEL
	int "kernel debug level"
	range 0 8
	default 7
	help
	  Kernel activated debug level, from 0 (no debug) upto 8 (all debug)
	  debug levels are the following:
	  - 0 : no debug
	  - 1 : emerg
	  - 2 : emerg, alert
	  - 3 : emerg, alert, critical
	  - 4 : emerg, alert, critical, error
	  - 5 : emerg, alert, critical, error, warning
	  - 6 : emerg, alert, critical, error, warning, notice
	  - 7 : emerg, alert, critical, error, warning, notice, info
	  - 8 : emerg, alert, critical, error, warning, notice, info, debug
	  autotest-specific logging is not impacted by debug level

endmenu

endif

menu "Security manager"

# symbols selected by build mode
config SECU_SSP_USER
	bool
	# support for user threads stack canaries

config SECU_SSP_KERN
	bool
	# support for kernel threads stack canaries

config SECU_HW_SETNCHECK
	bool
	---help---
	  when possible (may depend on the hardware device), double verify that
	  the target register configuration is valid and active
	# Unable set and check of critical hardware registers
	# (iowrite + ioread and compare)

config SECU_NO_WEAKTYPES
	bool
	---help---
	  Comparison to 0 lead to potential weak optimizations that should be
	  avoided in security critical environment. In the same way, hamming distance
	  of 1 can be easily faulted, in comparison with a discrete type

config SECU_LOOP_DBLE_IDX
	bool
	# Double index count and check in critical loops

config SECU_TASK_INTEGRITY_AT_BOOT
	bool

config SECU_ENFORCE_FAULT_INJECTION
	bool "Enforce fault injection projections"
	---help---
	  Enable this flag to enforce formally proven execution
	  paths with supplementary checks that whould have been dead
	  code in nominal execution

endmenu

endmenu
```
